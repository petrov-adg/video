## frameworks/qt5base/Config.in
```kconfig
menu "qt5base"
	depends on PACKAGE_qt5base

choice
	prompt "DoubleConversion"
	default QT5BASE_DOUBLECONVERSION_DISABLE

config QT5BASE_DOUBLECONVERSION_QT
	bool "QT variant"

config QT5BASE_DOUBLECONVERSION_SYSTEM
	bool "System library"

config QT5BASE_DOUBLECONVERSION_NO
	bool "Disable"

endchoice

choice
	prompt "QPA Backends"
	default QT5BASE_QPA_VNC

config QT5BASE_QPA_VNC
	bool "VNC"

config QT5BASE_QPA_DIRECTFB
	bool "DirectFB"

config QT5BASE_QPA_NONE
	bool "Disable"

endchoice

config QT5BASE_OPTIMIZE_SIZE
	bool "Optimize builds for size instant of speed"
	default n

endmenu
```
